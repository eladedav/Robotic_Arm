## main/Kconfig.projbuild
```kconfig
menu "Robotic Arm Configuration"

config ROBOT_WIFI_SSID
    string "Wi-Fi SSID"
    default ""
    help
        SSID for station mode connection.

config ROBOT_WIFI_PASSWORD
    string "Wi-Fi Password"
    default ""
    help
        Password for station mode connection.

endmenu
```
